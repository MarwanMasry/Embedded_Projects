 /******************************************************************************
 *
 * Module: Ultrasonic Module
 *
 * File Name: ultrasonic.c
 *
 * Description: Source file for the Ultrasonic driver.
 *
 * Author: Marwan Abdelhakim Elmasry
 *
 *******************************************************************************/

/*******************************************************************************
 *                              Includes Needed                                *
 *******************************************************************************/
#include "ultrasonic.h"
#include "icu.h"
#include "gpio.h"
#include <avr/delay.h>
#include "common_macros.h"

/*******************************************************************************
 *                          Private Function Prototype	                       *
 *******************************************************************************/

/*
 * Description:
 * This function is responsible for sending 10 usec pulse to Trigger the ultrasonic
 * sensor.
 */
static void Ultrasonic_trigger(void);


/*
 * Description :
 * This is the call back function called by the ICU driver, IT is used to
 *  calculate the high time (pulse time) generated by the ultrasonic sensor which
 *  is the time taken to travel and return from the object detected.
 */
static void Ultrasonic_edgeProcessing(void);


/*******************************************************************************
 *                      Private Global Variables Definitions                   *
 *******************************************************************************/

/*
 * It is used in edge processing function where according the number of edge
 * detected by ICU the behavior changes.
 */
static volatile uint8 g_edgeCount = 0;


/*
 * It is used to save the high time (pulse time) generated by the ultrasonic sensor
 * from the ECHO pin so that it is used in Calculating the distance.
 */
static volatile uint16 g_echoPinHighTime = 0;

/*
 * This flag is used to know if the Calculation of high time of ECHO pin is finished
 */
static volatile boolean g_echoPinHighTimeFlag = 0;

/*******************************************************************************
 *                        Private Function Definitions	                       *
 *******************************************************************************/

/*
 * Description:
 * This function is responsible for sending 10 usec pulse to Trigger the ultrasonic
 * sensor.
 */
static void Ultrasonic_trigger(void)
{
	/*	Sending a pulse with width at least 10 usec :
	 *  we will send 15 usec pulse to avoid errors.
	 *
	 * 	Trigger bit  = 0 : to make sure that when setting the bit a rising edge is triggered.
	 * 	Trigger bit  = 1 : Set high to make a rising edge
	 * 	delay 15 us to make the pulse
	 * 	Trigger bit  = 0
	 */
	GPIO_writePin(ULTRASONIC_TRIGGER_SIGNAL_PORT_ID , ULTRASONIC_TRIGGER_SIGNAL_PIN_ID , LOGIC_LOW);
	GPIO_writePin(ULTRASONIC_TRIGGER_SIGNAL_PORT_ID , ULTRASONIC_TRIGGER_SIGNAL_PIN_ID , LOGIC_HIGH);
	_delay_us(15);
	GPIO_writePin(ULTRASONIC_TRIGGER_SIGNAL_PORT_ID , ULTRASONIC_TRIGGER_SIGNAL_PIN_ID , LOGIC_LOW);
}

/*
 * Description :
 * This is the call back function called by the ICU driver, IT is used to
 * calculate the high time (pulse time) generated by the ultrasonic sensor which
 * is the time taken to travel and return from the object detected.
 */
static void Ultrasonic_edgeProcessing(void)
{
	/*	Increment the counter each time ICU detect an edge and ISR is executed	*/
	g_edgeCount++;


	if( 1 == g_edgeCount)	/*	Enter here after ICU detect Rising Edge	*/
	{
		/*	Clear the TCNT1 value so that it start count time form zero	*/
		ICU_clearTimerValue();

		/*	Set ICU to Detect Falling edge so that when the ECHO bit is set to
		 *  zero we can calculate the time to travel and return form certain
		 *  object.
		 */
		ICU_setEdgeDetectionType(FALLING_EDGE);
	}
	else if ( 2 == g_edgeCount)	/*	Enter here after ICU detect Falling Edge  */
	{
		/*	Save the Time where the sound wave travel and return from certain
		 * object.
		 */
		g_echoPinHighTime = ICU_getInputCaptureValue();

		/*	High  time Calculation is finished	*/
		g_echoPinHighTimeFlag = 1;


		/*	We need Set the edge count value to zero and make ICU detect rising
		 *  Edge so That when  calling the read function to read another distance
		 *  we start from the beginning.
		 */
		g_edgeCount = 0;
		ICU_setEdgeDetectionType(RISING_EDGE);
	}
}


/*******************************************************************************
 *                        Public Function Definitions	                       *
 *******************************************************************************/

/*
 * Description:
 * This function responsible for :
 * 1)Initialize the ICU driver as required.
 * 2)Setup the ICU call back function.
 * 3)Setup the direction for the trigger pin as output pin through the GPIO driver.
 */
void Ultrasonic_init(void)
{
	/*	Dynamic configuration for ICU	*/
	DynamicConfiguration_ICU	L_config = {F_CPU_DIV_BY_8 , RISING_EDGE};

	/*	Set the direction of the Trigger bit to Output	*/
	GPIO_setupPinDirection(ULTRASONIC_TRIGGER_SIGNAL_PORT_ID , ULTRASONIC_TRIGGER_SIGNAL_PIN_ID , PIN_OUTPUT);


	/*	Set the Call back function of the ICU driver to call when event occur	*/
	ICU_setCallBackFunction(Ultrasonic_edgeProcessing);

	/*	ICU Initialization	*/
	ICU_init(&L_config);

}

/*
 * Description:
 * This function will Send the trigger pulse by using Ultrasonic_Trigger function
 * to send the 8 pulses from the sensor to start calculating the time to travel and
 * return from the object and it Start the measurements by the ICU and return the
 * value of distance read.
 */

uint16 Ultrasonic_readDistance(void)
{
	/*	Distance calculated is stored in here	*/
	uint16 L_distance = 0 ;

	/*	Send the trigger pulse to the Ultrasonic Sensor	*/
	Ultrasonic_trigger();

	/*	Polling until calculation of High time at ECHO PIN is finished	*/
	while( !g_echoPinHighTimeFlag ) ;

	/*	Clear the flag so that when reading another distance the Polling loop
	 *  execute successfully.
	 */
	g_echoPinHighTimeFlag = 0;

	/* Sound velocity = 340.00 m/s = 34000 cm/s
	 * The distance of Object (in cm) = 340000∗Time /2 = 17000 * Time
	 *
	 * Here we have selected an internal 8MHz oscillator frequency for ATmega16,
	 * with Prescaler F_CPU/8 for timer frequency so the step is 1 usec.
	 * Distance = 17000 * Timer Value = 17000 x (TIMER value) x 1 x 10^-6 cm
	 * Distance = (17 * Timer Value) / 1000
	 *
	 * OR
	 *
	 * Distance = (Sound velocity/2) * Timer Value * Timer step
	 */
	L_distance = SOUND_velocity_IN_cmPERs_DIV_BY_2 * g_echoPinHighTime * TIMER_STEP ;

	return L_distance;
}

/*
 * Description:
 * This function turn off the Modules that is being used by Ultarsonic sensor
 * which is the Timer module.
 */
void Ultrasonic_deInit(void)
{
	ICU_deInit();
}




